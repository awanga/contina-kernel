## arch/arm/configs/goldengate_defconfig
```kconfig
CONFIG_EXPERIMENTAL=y
CONFIG_SYSVIPC=y
CONFIG_POSIX_MQUEUE=y
CONFIG_BSD_PROCESS_ACCT=y
CONFIG_IKCONFIG=y
CONFIG_IKCONFIG_PROC=y
CONFIG_LOG_BUF_SHIFT=14
CONFIG_NAMESPACES=y
# CONFIG_UTS_NS is not set
# CONFIG_IPC_NS is not set
# CONFIG_PID_NS is not set
# CONFIG_NET_NS is not set
CONFIG_BLK_DEV_INITRD=y
CONFIG_RD_BZIP2=y
CONFIG_RD_LZMA=y
CONFIG_RD_LZO=y
CONFIG_CC_OPTIMIZE_FOR_SIZE=y
CONFIG_SYSCTL_SYSCALL=y
# CONFIG_KALLSYMS is not set
CONFIG_EMBEDDED=y
# CONFIG_SLUB_DEBUG is not set
CONFIG_MODULES=y
CONFIG_MODULE_UNLOAD=y
CONFIG_BLK_DEV_INTEGRITY=y
CONFIG_PARTITION_ADVANCED=y
CONFIG_EFI_PARTITION=y
CONFIG_ARCH_GOLDENGATE=y
CONFIG_MACH_CORTINA_G2=y
CONFIG_CORTINA_WAN=y
CONFIG_PLATFORM_APB_CLK=150
CONFIG_CORTINA_G2_PCIE=y
CONFIG_CORTINA_G2_USB_HOST=y
# CONFIG_ARM_THUMB is not set
# CONFIG_SWP_EMULATE is not set
CONFIG_ARM_ERRATA_743622=y
CONFIG_ARM_ERRATA_751472=y
CONFIG_ARM_ERRATA_754322=y
CONFIG_SMP=y
CONFIG_VMSPLIT_2G=y
CONFIG_NR_CPUS=2
CONFIG_PREEMPT=y
CONFIG_AEABI=y
# CONFIG_OABI_COMPAT is not set
CONFIG_UACCESS_WITH_MEMCPY=y
CONFIG_ZBOOT_ROM_TEXT=0x0
CONFIG_ZBOOT_ROM_BSS=0x0
CONFIG_CMDLINE="root=/dev/ram0 rw console=ttyS0,115200 ramdisk_size=20480 debug ignore_loglevel"
CONFIG_VFP=y
CONFIG_NEON=y
# CONFIG_CORE_DUMP_DEFAULT_ELF_HEADERS is not set
CONFIG_BINFMT_MISC=y
CONFIG_NET=y
CONFIG_PACKET=y
CONFIG_UNIX=y
CONFIG_XFRM_USER=m
CONFIG_NET_KEY=m
CONFIG_INET=y
CONFIG_IP_MULTICAST=y
CONFIG_IP_PNP=y
CONFIG_IP_PNP_DHCP=y
CONFIG_IP_PNP_BOOTP=y
CONFIG_NET_IPIP=y
CONFIG_IP_MROUTE=y
CONFIG_INET_AH=m
CONFIG_INET_ESP=m
CONFIG_INET_IPCOMP=m
# CONFIG_INET_LRO is not set
# CONFIG_IPV6 is not set
CONFIG_NETFILTER=y
# CONFIG_BRIDGE_NETFILTER is not set
CONFIG_NETFILTER_NETLINK_QUEUE=m
CONFIG_NETFILTER_NETLINK_LOG=m
CONFIG_NF_CONNTRACK=y
CONFIG_NF_CONNTRACK_AMANDA=m
CONFIG_NF_CONNTRACK_FTP=m
CONFIG_NF_CONNTRACK_H323=m
CONFIG_NF_CONNTRACK_IRC=m
CONFIG_NF_CONNTRACK_PPTP=m
CONFIG_NF_CONNTRACK_SIP=m
CONFIG_NF_CONNTRACK_TFTP=m
CONFIG_NETFILTER_XT_TARGET_CLASSIFY=m
CONFIG_NETFILTER_XT_TARGET_CONNMARK=m
CONFIG_NETFILTER_XT_TARGET_DSCP=m
CONFIG_NETFILTER_XT_TARGET_MARK=m
CONFIG_NETFILTER_XT_TARGET_NOTRACK=m
CONFIG_NETFILTER_XT_TARGET_TCPMSS=m
CONFIG_NETFILTER_XT_MATCH_COMMENT=m
CONFIG_NETFILTER_XT_MATCH_CONNBYTES=m
CONFIG_NETFILTER_XT_MATCH_CONNMARK=m
CONFIG_NETFILTER_XT_MATCH_CONNTRACK=m
CONFIG_NETFILTER_XT_MATCH_DSCP=m
CONFIG_NETFILTER_XT_MATCH_ESP=m
CONFIG_NETFILTER_XT_MATCH_HASHLIMIT=m
CONFIG_NETFILTER_XT_MATCH_HELPER=m
CONFIG_NETFILTER_XT_MATCH_IPRANGE=m
CONFIG_NETFILTER_XT_MATCH_LENGTH=m
CONFIG_NETFILTER_XT_MATCH_LIMIT=m
CONFIG_NETFILTER_XT_MATCH_MAC=m
CONFIG_NETFILTER_XT_MATCH_MARK=m
CONFIG_NETFILTER_XT_MATCH_MULTIPORT=m
CONFIG_NETFILTER_XT_MATCH_OWNER=m
CONFIG_NETFILTER_XT_MATCH_POLICY=m
CONFIG_NETFILTER_XT_MATCH_PKTTYPE=m
CONFIG_NETFILTER_XT_MATCH_QUOTA=m
CONFIG_NETFILTER_XT_MATCH_RECENT=m
CONFIG_NETFILTER_XT_MATCH_STATE=m
CONFIG_NETFILTER_XT_MATCH_STATISTIC=m
CONFIG_NETFILTER_XT_MATCH_STRING=m
CONFIG_NETFILTER_XT_MATCH_TCPMSS=m
CONFIG_NETFILTER_XT_MATCH_TIME=m
CONFIG_NF_CONNTRACK_IPV4=y
# CONFIG_NF_CONNTRACK_PROC_COMPAT is not set
CONFIG_IP_NF_IPTABLES=m
CONFIG_IP_NF_MATCH_AH=m
CONFIG_IP_NF_MATCH_ECN=m
CONFIG_IP_NF_MATCH_TTL=m
CONFIG_IP_NF_FILTER=m
CONFIG_IP_NF_TARGET_REJECT=m
CONFIG_IP_NF_TARGET_ULOG=m
CONFIG_NF_NAT=m
CONFIG_IP_NF_TARGET_MASQUERADE=m
CONFIG_IP_NF_TARGET_NETMAP=m
CONFIG_IP_NF_TARGET_REDIRECT=m
CONFIG_IP_NF_MANGLE=m
CONFIG_IP_NF_TARGET_ECN=m
CONFIG_IP_NF_TARGET_TTL=m
CONFIG_IP_NF_RAW=m
CONFIG_IP_NF_ARPTABLES=m
CONFIG_IP_NF_ARPFILTER=m
CONFIG_IP_NF_ARP_MANGLE=m
CONFIG_BRIDGE=y
CONFIG_BRIDGE_PKT_FWD_FILTER=y
CONFIG_VLAN_8021Q=y
CONFIG_NET_SCHED=y
CONFIG_NET_SCH_HTB=m
CONFIG_NET_SCH_HFSC=m
CONFIG_NET_SCH_PRIO=m
CONFIG_NET_SCH_RED=m
CONFIG_NET_SCH_SFQ=m
CONFIG_NET_SCH_TEQL=m
CONFIG_NET_SCH_TBF=m
CONFIG_NET_SCH_GRED=m
CONFIG_NET_SCH_DSMARK=m
CONFIG_NET_SCH_INGRESS=m
CONFIG_NET_CLS_BASIC=y
CONFIG_NET_CLS_TCINDEX=m
CONFIG_NET_CLS_ROUTE4=m
CONFIG_NET_CLS_FW=m
CONFIG_NET_CLS_U32=m
CONFIG_CLS_U32_PERF=y
CONFIG_CLS_U32_MARK=y
CONFIG_NET_CLS_FLOW=m
CONFIG_NET_EMATCH=y
CONFIG_NET_EMATCH_CMP=m
CONFIG_NET_EMATCH_NBYTE=m
CONFIG_NET_EMATCH_U32=m
CONFIG_NET_EMATCH_META=m
CONFIG_NET_EMATCH_TEXT=m
CONFIG_NET_CLS_ACT=y
CONFIG_NET_ACT_POLICE=m
CONFIG_NET_ACT_MIRRED=m
CONFIG_NET_ACT_IPT=m
CONFIG_NET_ACT_SKBEDIT=y
CONFIG_NET_CLS_IND=y
CONFIG_UEVENT_HELPER_PATH="/sbin/hotplug"
CONFIG_MTD=y
CONFIG_MTD_TESTS=m
CONFIG_MTD_CMDLINE_PARTS=y
CONFIG_MTD_CHAR=y
CONFIG_MTD_BLOCK=y
CONFIG_MTD_OOPS=y
CONFIG_MTD_CS752X_MULTIFLASH=y
CONFIG_MTD_CFI=y
CONFIG_MTD_COMPLEX_MAPPINGS=y
CONFIG_MTD_NAND=y
CONFIG_MTD_CORTINA_CS752X_NAND=y
CONFIG_BLK_DEV_RAM=y
CONFIG_BLK_DEV_RAM_COUNT=4
CONFIG_BLK_DEV_RAM_SIZE=51200
CONFIG_BLK_DEV_SD=y
CONFIG_BLK_DEV_SR=y
CONFIG_CHR_DEV_SG=y
CONFIG_CHR_DEV_SCH=y
CONFIG_SCSI_MULTI_LUN=y
CONFIG_ATA=y
CONFIG_CS752X_AHCI=y
# CONFIG_ATA_BMDMA is not set
CONFIG_NETDEVICES=y
CONFIG_TIGON3=y
CONFIG_CS752X=y
CONFIG_CS752X_ACCEL_KERNEL=y
CONFIG_CS752X_FASTNET=y
CONFIG_CS752X_HW_ACCELERATION=y
CONFIG_CS752X_HW_ACCELERATION_IPSEC=y
CONFIG_CS752X_HW_ACCEL_ETHERIP=y
CONFIG_CS75XX_WFO=y
CONFIG_CS75XX_FE_TBL_MGMT_UT=m
CONFIG_SMC91X=y
CONFIG_SMSC911X=y
CONFIG_SMSC_PHY=y
CONFIG_PPP=m
CONFIG_PPP_FILTER=y
CONFIG_PPP_MULTILINK=y
CONFIG_PPPOE=m
CONFIG_PPP_ASYNC=m
# CONFIG_WLAN is not set
CONFIG_INPUT_POLLDEV=m
CONFIG_INPUT_EVDEV=y
# CONFIG_KEYBOARD_ATKBD is not set
CONFIG_KEYBOARD_GPIO=m
CONFIG_INPUT_MISC=y
# CONFIG_SERIO_SERPORT is not set
CONFIG_SERIO_AMBAKMI=y
CONFIG_LEGACY_PTY_COUNT=16
CONFIG_SERIAL_CORTINA=y
CONFIG_SERIAL_CORTINA_CONSOLE=y
CONFIG_HW_RANDOM=y
CONFIG_HW_RANDOM_CS75XX=y
CONFIG_I2C=y
# CONFIG_I2C_COMPAT is not set
CONFIG_I2C_CHARDEV=m
# CONFIG_I2C_HELPER_AUTO is not set
CONFIG_I2C_CS75XX=y
CONFIG_SPI=y
CONFIG_SPI_CS75XX=y
CONFIG_SPI_AGENT=y
CONFIG_GPIOLIB=y
CONFIG_GPIO_SYSFS=y
CONFIG_GPIO_CS75XX=y
# CONFIG_HWMON is not set
CONFIG_WATCHDOG=y
CONFIG_G2_WATCHDOG=y
CONFIG_USB=y
CONFIG_USB_ANNOUNCE_NEW_DEVICES=y
CONFIG_USB_EHCI_HCD=y
CONFIG_USB_OHCI_HCD=y
CONFIG_USB_STORAGE=y
CONFIG_USB_STORAGE_DATAFAB=y
CONFIG_USB_STORAGE_FREECOM=y
CONFIG_USB_STORAGE_USBAT=y
CONFIG_USB_STORAGE_SDDR09=y
CONFIG_USB_STORAGE_SDDR55=y
CONFIG_USB_STORAGE_JUMPSHOT=y
CONFIG_USB_STORAGE_ALAUDA=y
CONFIG_USB_STORAGE_KARMA=y
CONFIG_MMC=y
CONFIG_CS752X_SD=y
CONFIG_RTC_CLASS=y
CONFIG_RTC_DRV_G2=y
CONFIG_DMADEVICES=y
CONFIG_CORTINA_G2_ADMA=y
CONFIG_EXT2_FS=y
CONFIG_EXT2_FS_XATTR=y
CONFIG_EXT2_FS_POSIX_ACL=y
CONFIG_EXT2_FS_SECURITY=y
CONFIG_EXT3_FS=y
# CONFIG_EXT3_DEFAULTS_TO_ORDERED is not set
CONFIG_EXT3_FS_POSIX_ACL=y
CONFIG_EXT3_FS_SECURITY=y
CONFIG_EXT4_FS=y
CONFIG_EXT4_FS_POSIX_ACL=y
CONFIG_QUOTA=y
CONFIG_AUTOFS4_FS=y
CONFIG_ISO9660_FS=y
CONFIG_JOLIET=y
CONFIG_ZISOFS=y
CONFIG_UDF_FS=y
CONFIG_VFAT_FS=y
CONFIG_TMPFS=y
CONFIG_JFFS2_FS=y
CONFIG_JFFS2_SUMMARY=y
CONFIG_JFFS2_COMPRESSION_OPTIONS=y
# CONFIG_JFFS2_ZLIB is not set
CONFIG_SQUASHFS=y
CONFIG_SQUASHFS_LZO=y
CONFIG_SQUASHFS_XZ=y
CONFIG_SQUASHFS_EMBEDDED=y
CONFIG_NLS_CODEPAGE_437=y
CONFIG_NLS_ISO8859_1=y
CONFIG_PRINTK_TIME=y
# CONFIG_ENABLE_WARN_DEPRECATED is not set
# CONFIG_ENABLE_MUST_CHECK is not set
CONFIG_DEBUG_FS=y
# CONFIG_DEBUG_PREEMPT is not set
CONFIG_DEBUG_INFO=y
# CONFIG_FTRACE is not set
# CONFIG_ARM_UNWIND is not set
CONFIG_CRYPTO_NULL=m
CONFIG_CRYPTO_AUTHENC=y
CONFIG_CRYPTO_TEST=m
CONFIG_CRYPTO_ECB=m
CONFIG_CRYPTO_CRC32C=y
CONFIG_CRYPTO_AES=m
# CONFIG_CRYPTO_ANSI_CPRNG is not set
```

## arch/arm/mach-goldengate/Kconfig
```kconfig
menu "Cortina-System platform type"
	depends on ARCH_GOLDENGATE

config MACH_CORTINA_G2
	bool "Support Cortina-System G2 platform"
	select ARM_GIC
	select CPU_V7
	select NEED_MACH_IO_H
	select HAVE_PWM
	help
	  Include support for Cortex-A9 CPU on Cortina-Systems Baseboard.

choice
	prompt "G2 Platform Type"
	default CORTINA_CUSTOM_BOARD
	help
	  Pick the G2 platform to build

config CORTINA_CUSTOM_BOARD
	bool "G2 SoC Based Custom Board"
	select NEED_MACH_IO_H
	help
	  Support for Custom Board Designs.

config CORTINA_FPGA
       bool "FPGA Verification Board"
       help
         Support for the Golden-Gate FPGA board.

config CORTINA_ENGINEERING
       bool "Engineering Board(CS754x)"
       select NEED_MACH_IO_H
       help
         Support for the Golden-Gate engineering board.

config CORTINA_ENGINEERING_S
       bool "Engineering Board Small package(CS752x)"
       select NEED_MACH_IO_H
       help
         Support for the Golden-Gate engineering board small package(CS7422).


config CORTINA_REFERENCE
       bool "Reference Board(CS754x)"
       select NEED_MACH_IO_H
       help
         Support for the Golden-Gate reference board.

config CORTINA_REFERENCE_B
       bool "Reference Board Ver.B(CS754x)"
       select NEED_MACH_IO_H
       help
         Support for the Golden-Gate reference board version B.


config CORTINA_REFERENCE_S
       bool "Reference Board Small package(CS752x)"
       select NEED_MACH_IO_H
       help
         Support for the Golden-Gate reference small package(CS7522).

config CORTINA_REFERENCE_Q
       bool "Reference Board package(CS754x) for Q "
       select NEED_MACH_IO_H
       help
         Support for the Golden-Gate reference package(CS7542).

config CORTINA_PON
       bool "PON Board package(CS754x)"
       select NEED_MACH_IO_H
       help
         Support for the Golden-Gate (CS7542) with PON.

config CORTINA_BHR
       bool "BHR Board package(CS754x)"
       select NEED_MACH_IO_H
       help
         Support for the Golden-Gate (CS7542) with BHR.

config CORTINA_WAN
       bool "Wan Board (CS754x)"
       select NEED_MACH_IO_H
       help
         Support for the Golden-Gate wan board .

endchoice

config ARCH_SUPPORTS_BIG_ENDIAN
        bool
        default y

config ACP
        bool "Support ACP(Accelerator Coherency Port)"
        depends on MACH_CORTINA_G2 && !CORTINA_FPGA
        help
          Support for the Golden-Gate ASIC. The Accelerator Coherency Port (ACP) is a feature
          of Cortex-A9, which provides an AXI slave port that can be connected to a DMA engine,
          providing the DMA access to the SCU of Cortex-A9. Addresses on the ACP port are physical
          addresses which can be snooped by the SCU to provide full I/O coherency.

config PLATFORM_APB_CLK
        int "Default APB clock speed(MHZ)"
        default "100"
        depends on MACH_CORTINA_G2 && !CORTINA_FPGA
        help
          There are three different APB clock for different HW strap pin.
          100 for CPU clock 400, 600, 700, 800 and 900 MHz(Strap 0~4)
          150 for CPU clock 750 MHz(Strap 5)
          170 for CPU clock 850 MHz(Strap 6)

config CS75XX_SSP
        bool "Support SSP(Synchronous Serial Port)"
        depends on MACH_CORTINA_G2
        help
          SSP can send PCM voice data for SLIC or I2C audio data to DAC.

menuconfig CORTINA_G2_PCIE
	bool "Support Cortina-System G2 PCIe "
	select PCI
	select ARCH_SUPPORTS_MSI
	select PCI_SYSCALL
	select PCI_MSI
	select PCI_LEGACY
  help
	  Include support PCIe for Cortex-A9 CPU on Cortina-Systems Baseboard.

if CORTINA_G2_PCIE
config PCIE_EXTERNAL_CLOCK
        bool "Use external clock for PCIe"
        depends on CORTINA_G2_PCIE=y
        default y 
        help
          Use external clock or internal clock for PCIe.
endif

config CORTINA_G2_USB_HOST
	bool "Support Cortina-System G2 USB Host driver"
	select USB_ARCH_HAS_EHCI
	select USB_ARCH_HAS_OHCI
	help
	  Include support USB host for Cortex-A9 CPU on Cortina-Systems Baseboard.

config CORTINA_DISABLE_USB_PHY0_CLOCK
	bool "Disable USB PHY0 clock, when USB suspend/resume"
	help
	  Enable/Disable USB PHY0 clock, when USB suspend/resume.

config CORTINA_GKCI
	bool "Enable Cortina-specific Generic Kernel Contaminations"
	default y
	help
	  Enable/Disable Cortina-specific GKCIs previously unmarked.

config CORTINA_G2_GLOBAL_TIMER
	bool "Enable Cortina g2 global timer."
	default y
	help
	  Enable/Disable Cortina g2 global timer.

endmenu

# Custom Board SDK Menu
source "arch/arm/mach-goldengate/include/mach/custom_board/Kconfig"
```

## arch/arm/mach-goldengate/include/mach/custom_board/Kconfig
```kconfig
menu "G2 Custom Board ID"
	depends on CORTINA_CUSTOM_BOARD

choice
	prompt "G2 Custom Board ID"
# patch start HERE:
#
#  Apply a patch to modify this file to replace everything between the start HERE and stop HERE comments lines
#  including the comment lines themselves.
#
#  WARNING: DO NOT MODIFIY THIS FILE DIRECTLY!!!  This file will be overwritten iIn future Cortina releases.
#  Apply a patch to modify this file instead. 
# 
#  Change default as desired.
	default CORTINA_CUSTOM_BOARD_ID_TEMPLATE
	help
  	  Pick the G2 platform to build
# Please leave the template board as an available type, just add more boards and change the default above
# as desired.
source "arch/arm/mach-goldengate/include/mach/custom_board/template/cfg_Kconfig.custom.board.id"
#source "arch/arm/mach-goldengate/include/mach/custom_board/myboard_name/cfg_Kconfig.custom.board.id"

# patch end HERE:

endchoice

# patch start HERE:
#
#  Apply a patch to modify this file to replace everything between the start HERE and stop HERE comments lines
#  including the comment lines themselves.
#
#  WARNING: DO NOT MODIFIY THIS FILE DIRECTLY!!!  This file will be overwritten iIn future Cortina releases.
#  Apply a patch to modify this file instead. 
# 
# If your Custom Board has additional features controlled by Kconfig, you can patch in your Custom Kconfig 
# hook location below. This enables creation of new menus as desired. 
# for example:
#
source "arch/arm/mach-goldengate/include/mach/custom_board/template/Kconfig"
#source "arch/arm/mach-goldengate/include/mach/custom_board/myboard_name/Kconfig"
#
# patch end HERE:

endmenu
```

## arch/arm/mach-lynxe/Kconfig
```kconfig
menu "LynxE based"
	depends on ARCH_CS_LYNXE
config REF_BOARD
        bool "Reference Board"
        default y
        help
          This enables Reference Board specific code on Cortina LynxE based platforms.
	  If you have such a board, say 'Y'.
	  This includes specific configurations for the board and its peripherals.

config LYNXE_PERIPHERAL_FREQ
        int "Peripheral clock freq in Hz"
        default  100000000
        help
        Selects the peripheral clock frequency used
        by the timer and uart. Peripheral clock frequency 
        for lynxe is DDR clock frequency / 4.
        Default is 100Mhz as DDR clock frequency default is 400Mhz

config LYNXE_FLASH_SIZE
        int "LynxE Flash size"
        default 16777216
        help
        Specifies the flash size in bytes available
        in the board. Default is 16MB [16777216]

config LYNXE_PAYLOAD_MEMBASE
        int "LynxE Payload Memory base address"
        default 1140850688 
        help
        Specifies the payload DDR base address
        Default is 0x44000000 [1140850688]

config LYNXE_PAYLOAD_MEMSIZE
        int "LynxE Payload Memory size"
        default 201326592 
        help
        Specifies the payload DDR size in bytes
        Default is 192MBytes [201326592]

config LYNXE_KERNEL_HOOK
        bool "LynxE Kernel Hook Support"
        default n 
        help
          This enables kernel hook support for NI driver fast path.
          If you would like to have NI driver fast path support, say 'Y'.

endmenu
```

## drivers/media/dvb/cs752x-ts/Kconfig
```kconfig
config DVB_CS75XX_TS
	tristate "CS75XX Transport Stream"
	depends on DVB_CORE
	help
          Since this module have no MPEG decoder onboard, they transmit
	  only compressed MPEG data over the AXI bus, so you need
	  an external software decoder to watch TV on your computer.

	  Say Y or M if you own such a device and want to use it.

config DVB_MXL241SF
        bool "Use with MxL241SF Tuner/Demodulator kernel module"
        depends on DVB_CS75XX_TS
        help
          If you are using this module along with the MxL241SF, then
          you should select this option.
```
