## drivers/staging/telephony/Kconfig
```kconfig
#
# Telephony device configuration
#

menuconfig PHONE
	tristate "Telephony support"
	depends on HAS_IOMEM
	---help---
	  Say Y here if you have a telephony card, which for example allows
	  you to use a regular phone for voice-over-IP applications.

	  Note: this has nothing to do with modems.  You do not need to say Y
	  here in order to be able to use a modem under Linux.

	  To compile this driver as a module, choose M here: the
	  module will be called phonedev.

if PHONE

config PHONE_IXJ
	tristate "QuickNet Internet LineJack/PhoneJack support"
	depends on ISA || PCI
	---help---
	  Say M if you have a telephony card manufactured by Quicknet
	  Technologies, Inc.  These include the Internet PhoneJACK and
	  Internet LineJACK Telephony Cards. You will get a module called
	  ixj.

	  For the ISA versions of these products, you can configure the
	  cards using the isapnp tools (pnpdump/isapnp) or you can use the
	  isapnp support.  Please read <file:Documentation/telephony/ixj.txt>.

	  For more information on these cards, see Quicknet's web site at:
	  <http://www.quicknet.net/>.

	  If you do not have any Quicknet telephony cards, you can safely
	  say N here.

config PHONE_IXJ_PCMCIA
	tristate "QuickNet Internet LineJack/PhoneJack PCMCIA support"
	depends on PHONE_IXJ && PCMCIA
	help
	  Say Y here to configure in PCMCIA service support for the Quicknet
	  cards manufactured by Quicknet Technologies, Inc.  This changes the
	  card initialization code to work with the card manager daemon.

config PHONE_CS75XX_WRAPPER
	tristate "Cortina CS75XX phone wrapper"
	depends on ARCH_GOLDENGATE

config PHONE_CS75XX_SPI_16BITS_PERWORD
	tristate "Cortina CS75XX phone wrapper support 16bits SPI transfer"
	depends on PHONE_CS75XX_WRAPPER	
	
config  SLIC_SI3226X_SLOT0
	select PHONE_CS75XX_SPI_16BITS_PERWORD
	tristate "Cortina CS75XX SLIC SI3226X bind with SPI chip select 0"
	depends on PHONE_CS75XX_WRAPPER

config  SLIC_SI3226X_SLOT1
	select PHONE_CS75XX_SPI_16BITS_PERWORD
	tristate "Cortina CS75XX SLIC SI3226X bind with SPI chip select 2"
	depends on PHONE_CS75XX_WRAPPER	
	
config  SLIC_VE880_SLOT0
	tristate "Cortina CS75XX ZARLINK VE880 plug in slot0"
	depends on PHONE_CS75XX_WRAPPER

config  SLIC_VE880_SLOT1
	tristate "Cortina CS75XX ZARLINK VE880 plug in slot1"
	depends on PHONE_CS75XX_WRAPPER
	

	
endif # PHONE
```

## sound/soc/cs75xx/Kconfig
```kconfig
config SND_CS75XX_SOC
	tristate "SoC Audio for the Cortina Systems CS75XX chip"
	depends on ARCH_GOLDENGATE
	help
	  Say Y or M if you want to add support for codecs attached to
	  the DAVINCI AC97 or I2S interface. You will also need
	  to select the audio interfaces to support below.
  
config SND_CS75XX_SOC_EVM
	tristate "SoC Audio support for CS75XX EVM"
	depends on ARCH_GOLDENGATE && SND_CS75XX_SOC
	help
	  Say Y if you want to add support for SoC audio on Cortina Systems
	  CS75XX EVM platforms.

choice
	depends on SND_CS75XX_SOC_EVM
	prompt "Codec Select"
	default SND_CS75XX_SOC_EVM_SPDIF
	help
	  Select codec on EVM!

config SND_CS75XX_SOC_EVM_SPDIF
	tristate "SPDIF"
	depends on ARCH_GOLDENGATE
	select SND_SOC_SPDIF
	help
	  SPDIF output

config SND_CS75XX_SOC_EVM_DAE4P
	tristate "DAE4P"
	depends on ARCH_GOLDENGATE
	select SND_SOC_DAE4P
	help
	  DAE4P with I2S output

endchoice
```
